/*
 * Copyright (c) 2023 The ZMK Contributors
 * SPDX-License-Identifier: MIT
 */

#include "ownkb.dtsi"

&default_transform {
    col-offset = <6>;
};

&kscan0 {
    diode-direction = "row2col";
    row-gpios
        = <&pro_micro 19 (GPIO_ACTIVE_LOW)>
        , <&pro_micro 18 (GPIO_ACTIVE_LOW)>
        , <&pro_micro 15 (GPIO_ACTIVE_LOW)>
        , <&pro_micro 14 (GPIO_ACTIVE_LOW)>
        , <&pro_micro 16 (GPIO_ACTIVE_LOW)>
        , <&pro_micro 10 (GPIO_ACTIVE_LOW)>
        ;
    col-gpios
        = <&pro_micro 5 (GPIO_ACTIVE_LOW | GPIO_PULL_UP)>
        , <&pro_micro 6 (GPIO_ACTIVE_LOW | GPIO_PULL_UP)>
        , <&pro_micro 7 (GPIO_ACTIVE_LOW | GPIO_PULL_UP)>
        , <&pro_micro 8 (GPIO_ACTIVE_LOW | GPIO_PULL_UP)>
        , <&pro_micro 9 (GPIO_ACTIVE_LOW | GPIO_PULL_UP)>
        ;
};

&right_encoder {
    status = "okay";
};
