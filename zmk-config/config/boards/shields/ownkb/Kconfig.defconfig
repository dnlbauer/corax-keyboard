## zmk-config/config/boards/shields/ownkb/Kconfig.defconfig
```kconfig
# Copyright (c) 2023 The ZMK Contributors
# SPDX-License-Identifier: MIT

if SHIELD_OWNKB_LEFT

config ZMK_KEYBOARD_NAME
    default "ownkb"

config ZMK_SPLIT_ROLE_CENTRAL
    default y

endif

if SHIELD_OWNKB_LEFT || SHIELD_OWNKB_RIGHT

config ZMK_SPLIT
    default y

endif
```

## zmk-config/config/boards/shields/ownkb/Kconfig.shield
```kconfig
# Copyright (c) 2023 The ZMK Contributors
# SPDX-License-Identifier: MIT


config SHIELD_OWNKB_LEFT
    def_bool $(shields_list_contains,ownkb_left)

config SHIELD_OWNKB_RIGHT
    def_bool $(shields_list_contains,ownkb_right)
```
